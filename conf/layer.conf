## conf/layer.conf
```bitbake
# We have a conf and classes directory, add to BBPATH
BBPATH .= ":${LAYERDIR}"

# We have a packages directory, add to BBFILES
BBFILES += "${LAYERDIR}/recipes-*/*/*.bb \
            ${LAYERDIR}/recipes-*/*/*.bbappend"

BBFILE_COLLECTIONS += "meta-r1701-public"
BBFILE_PATTERN_meta-r1701-public := "^${LAYERDIR}/"
BBFILE_PRIORITY_meta-r1701-public = "92"

# Define that this layer comply with what YOCTO version.
LAYERDEPENDS_meta-r1701-public = "variscite-fslc"
LAYERSERIES_COMPAT_meta-r1701-public = "dunfell"
```

## conf/machine/r1701.conf
```bitbake
#@TYPE: Machine
#@NAME: HACH r1701 platform
#@DESCRIPTION: Machine configuration for r1701 platform.

# Include the machine configuration for Digi's ConnectCore 6UL.
include conf/machine/include/ccimx6ul.inc

# Set software version, this version is the version of r1701 firmware
SOFTWARE_VERSION ?= "0.1"

# Specify git location of r1701_fw source for this build.
FW_BRANCH ?= "develop"
FW_COMMIT ?= "${AUTOREV}"

# U-Boot configurations
# Last one is the default (the one the symlinks point at)
UBOOT_CONFIG ??= "r1701"
UBOOT_CONFIG[r1701] = "r1701_defconfig,,u-boot-dtb.${UBOOT_SUFFIX}"

# U-Boot environment offset (within partition)
UBOOT_ENV_OFFSET ?= "0x0"

# U-Boot environment size
UBOOT_ENV_SIZE ?= "0x20000"

# U-Boot environment range: size (in hex) in the environment partition that
# the U-Boot environment can take up (if undefined, it will take up all the
# available space in the environment partition)
UBOOT_ENV_RANGE ?= ""

KERNEL_DEVICETREE ?= " \
    imx6ul-r1701-mpp.dtb \
    imx6ul-r1701-hpp.dtb \
"

# Recovery initramfs image name.
RECOVERY_INITRAMFS_IMAGE = "hqseries-portable-recovery-image"

SERIAL_CONSOLES ?= "115200;ttymxc4"

# Bluetooth tty
#BT_TTY ?= "ttymxc0"

# U-Boot script to be copied to the boot image
BOOT_SCRIPTS = "boot.scr:boot.scr"

# Flash image types
IMAGE_FSTYPES ?= "tar.bz2 ubifs boot.ubifs recovery.ubifs"

# Remove X11.
DISTRO_FEATURES_remove += "x11"

# Set graphical backend
GRAPHICAL_BACKEND = "fb"

#Automatically load the usb battery charger driver
KERNEL_MODULE_AUTOLOAD += "bq25890_charger"

MACHINE_FEATURES_remove += "alsa touchscreen wifi bluetooth"

#Remove sound and touchscreen related features.
MACHINE_EXTRA_RRECOMMENDS_remove += " \
    imx-alsa-plugins \
    cryptoauthlib \
    cryptodev-module \
    {MACHINE_FIRMWARE} \
    {WIRELESS_MODULE} \
"

# Extra machine features.
MACHINE_FEATURES += "vfat ext4"

# Exclude packages from the build.
PACKAGE_EXCLUDE += "\
    packagegroup-dey-wireless \
    packagegroup-dey-bluetooth \
    packagegroup-dey-examples \
    packagegroup-dey-gstreamer \
    packagegroup-core-ssh-dropbear \
    packagegroup-core-x11 \
    packagegroup-core-x11-base \
    packagegroup-core-x11-sato \
"
```
